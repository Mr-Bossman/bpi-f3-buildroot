## configs/bananapi_f3_upstreaming_defconfig
```kconfig
# Architecture
BR2_riscv=y
BR2_RISCV_ISA_RVC=y
BR2_RISCV_ISA_RVV=y

# System
BR2_GCC_VERSION_14_X=y
BR2_SYSTEM_DHCP="eth0"
BR2_TARGET_GENERIC_GETTY=y

# Filesystem
BR2_TARGET_ROOTFS_CPIO=y
BR2_TARGET_ROOTFS_CPIO_GZIP=y
BR2_TARGET_ROOTFS_EXT2=y
BR2_TARGET_ROOTFS_EXT2_4=y
BR2_TARGET_ROOTFS_EXT2_SIZE="100M"
BR2_ROOTFS_OVERLAY="$(BR2_EXTERNAL)/board/bananapi/bananapi-f3/rootfs_overlay"

# Image
BR2_ROOTFS_POST_IMAGE_SCRIPT="support/scripts/genimage.sh"
BR2_ROOTFS_POST_SCRIPT_ARGS="-c $(BR2_EXTERNAL)/board/bananapi/bananapi-f3/genimage.cfg"
BR2_ROOTFS_POST_BUILD_SCRIPT="$(BR2_EXTERNAL)/board/bananapi/bananapi-f3/post-build.sh"

# Linux headers same as kernel
BR2_PACKAGE_HOST_LINUX_HEADERS_CUSTOM_6_9=y

# Kernel
BR2_LINUX_KERNEL=y
BR2_LINUX_KERNEL_CUSTOM_GIT=y
BR2_LINUX_KERNEL_CUSTOM_REPO_URL="ssh://git@github.com/mr-bossman/linux.git"
BR2_LINUX_KERNEL_CUSTOM_REPO_VERSION="d6b5fc1e1d438e8f83580db85fe54dadd07425ed"
BR2_LINUX_KERNEL_USE_ARCH_DEFAULT_CONFIG=y
BR2_LINUX_KERNEL_IMAGE=y
BR2_LINUX_KERNEL_DTS_SUPPORT=y
BR2_LINUX_KERNEL_INTREE_DTS_NAME="spacemit/k1-bananapi-f3"

# OpenSBI
BR2_TARGET_OPENSBI=y
BR2_TARGET_OPENSBI_CUSTOM_GIT=y
BR2_TARGET_OPENSBI_CUSTOM_REPO_URL="ssh://git@github.com/cyyself/opensbi.git"
BR2_TARGET_OPENSBI_CUSTOM_REPO_VERSION="afc26173a776a9b4b4a7730dc17f9c0841f95cba"
BR2_TARGET_OPENSBI_PLAT="generic"

# U-Boot
BR2_TARGET_UBOOT=y
BR2_TARGET_UBOOT_BOARDNAME="k1"
BR2_TARGET_UBOOT_CUSTOM_GIT=y
BR2_TARGET_UBOOT_CUSTOM_REPO_URL="ssh://git@github.com/BPI-SINOVOIP/pi-u-boot.git"
BR2_TARGET_UBOOT_CUSTOM_REPO_VERSION="2aa062b0567d3863d700021990de89ba6b616c8f"
BR2_TARGET_UBOOT_FORMAT_ITB=y
BR2_TARGET_UBOOT_FORMAT_CUSTOM=y
BR2_TARGET_UBOOT_FORMAT_CUSTOM_NAME="FSBL.bin"

# U-Boot Tools
BR2_PACKAGE_HOST_UBOOT_TOOLS=y
BR2_PACKAGE_HOST_UBOOT_TOOLS_FIT_SUPPORT=y
BR2_PACKAGE_HOST_UBOOT_TOOLS_FIT_SIGNATURE_SUPPORT=y

# Host tools
BR2_PACKAGE_HOST_GENIMAGE=y
```
